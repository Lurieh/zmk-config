## config/west.yml
```yaml
manifest:
  remotes:
    - name: zmkfirmware
      url-base: https://github.com/zmkfirmware
    - name: munnich
      url-base: https://github.com/nmunnich
  projects:
    - name: zmk
      remote: zmkfirmware
      revision: e34793e8c7193bc868b95ec38d78f67956f759cb  # ← PINNED
      import: app/west.yml
    - name: zmk-apiaster-module
      remote: munnich
      revision: main
      import: config/west.yml
  self:
    path: config
```
